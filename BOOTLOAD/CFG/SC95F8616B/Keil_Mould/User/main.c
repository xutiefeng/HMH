//************************************************************
//  Copyright (c)  
//	FileName	  : main.c
//	Function	  : Main Function
//  Instructions  : Contains the MCU initialization function and its H file
//************************************************************
/********************Includes************************************************************************/
#include "SC_Init.h"	// MCU initialization header file, including all firmware library header files
#include "SC_it.h"
#include "..\Drivers\SCDriver_list.h"
#include "HeadFiles\SysFunVarDefine.h"


/**************************************Generated by EasyCodeCube*************************************/
//Forbid editing areas between the labels !!!

/*************************************.Generated by EasyCodeCube.************************************/


/*****************************************************************************************************
* Function Name: main
* Description  : This function implements main function.
* Arguments    : None
* Return Value : None
******************************************************************************************************/
void main(void)
{	
#if(LDROM_MODE==0)
    SetInterruptAPP();
#endif
    /*<Generated by EasyCodeCube begin>*/
    /*<UserCodeStart>*//*<SinOne-Tag><36>*/
    IcResourceInit();
    /*<UserCodeEnd>*//*<SinOne-Tag><36>*/
    /*<UserCodeStart>*//*<SinOne-Tag><60>*/
    OTA_Init(IOT_Uart_Receiver,&IOT_Uart_DataBuf);
    IOT_Init(0);
    /*<UserCodeEnd>*//*<SinOne-Tag><60>*/
    /*<UserCodeStart>*//*<SinOne-Tag><4>*/
    /*****MainLoop*****/
    while(1)
    {
        /*<UserCodeStart>*//*<SinOne-Tag><14>*/
        /***User program***/
        WDTCON |=0x10;
        
        if(IOT_GET_FW==IOT_Work())                        //IOT平台交互命令处理
        {
#if(FIRMWARE_DOWMLOADER_MODE==0) //在BOOT中下载固件
            OTA_JumpBoot();             //复位到BOOT，在BOOT中下载固件并更新到APP区
#endif
        }
        
#if(FIRMWARE_DOWMLOADER_MODE==1)
        OTA_FirmwareDownload(&IAP_Pack);   //从IOT平台下载固件
        
        if(IAP_Pack.Size!=0)                       //完成一包数据接收
        {
            unsigned int IapLen;
            BootLoadInit();                         //开放IAP操作区域
            IapLen=SaveOTA_to_BacksArea(&IAP_Pack); //将APP写入备份区
            if(IapLen!=0)                           //写入成功
            {
                IAP_Pack.State=OTA_IAPWRITED;
            }
            else
            {
                IAP_Pack.State=OTA_FAULT;             //下载失败
            }
            IAP_Pack.Size=0;
            BootLoad_DeInit();                        //恢复IAP操作区域
        }			
        if(IAP_Pack.State==OTA_COMPLETE)     //下载完成是，IAP_Pack.State置为OTA_COMPLETE状态
        {
            BootLoadInit();                   //开放IAP操作区域
            if (!IAP_BacksArea_CrcCheck())    //检查下载到备份区代码的Crc       
            {
                BootLoad_DeInit();            //恢复IAP操作区域
                IAP_Pack.State=OTA_FAULT;     //下载失败
            }
            else                              //校验通过
            {
                BootLoad_DeInit();            //恢复IAP操作区域
                OTA_JumpBoot();             //复位到BOOT，将备份区更新到APP区
            }
        }	
        
        if(IAP_Pack.State==OTA_FAULT)  //出错处理
        {
            OTA_Init(IOT_Uart_Receiver,&IOT_Uart_DataBuf);
            IOT_Init(0);
        }		
#endif
        /*<UserCodeEnd>*//*<SinOne-Tag><14>*/
        /*<Begin-Inserted by EasyCodeCube for Condition>*/
    }
    /*<UserCodeEnd>*//*<SinOne-Tag><4>*/
    
    /*<Generated by EasyCodeCube end>*/
}
